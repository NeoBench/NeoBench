## kernel_mods/Kconfig.bus.patch
```kconfig
# SPDX-License-Identifier: GPL-2.0
if MMU

comment "Bus Support"

config DIO
	bool "DIO bus support"
	depends on HP300
	default y
	help
	  Say Y here to enable support for the "DIO" expansion bus used in
	  HP300 machines. If you are using such a system you almost certainly
	  want this.

config NUBUS
	bool
	depends on MAC
	default y

config ZORRO
	bool "Amiga Zorro (AutoConfig) bus support"
	depends on AMIGA
	help
	  This enables support for the Zorro bus in the Amiga.

config NEOBENCH_MEDIATOR_PCI
	bool "NeoBench: Elbox Mediator PCI Busboard Support"
	depends on ZORRO && NEOBENCH
	select HAVE_PCI
	select PCI
	help
	  Experimental native support for the Elbox Mediator PCI busboard.
	  This maps the PCI configuration and memory spaces via Zorro III
	  into the Linux kernel, allowing standard PCI drivers to work.

config NEOBENCH_SONNET_PPC
	bool "NeoBench: PCI PowerPC Coprocessor Support"
	depends on NEOBENCH_MEDIATOR_PCI
	help
	  Experimental support for PCI-based PowerPC accelerators (like the
	  Sonnet Crescendo) installed in the Mediator busboard. This enables
	  the m68k kernel to offload tasks or boot a secondary OS on the PPC.

config AMIGA_PCMCIA
	bool "Amiga 1200/600 PCMCIA support"
	depends on AMIGA
	help
	  Include support in the kernel for pcmcia on Amiga 1200 and Amiga
	  600. If you intend to use pcmcia cards say Y; otherwise say N.

config ISA
	bool
	depends on Q40 || AMIGA_PCMCIA
	default y
	help
	  Find out whether you have ISA slots on your motherboard.  ISA is the
	  name of a bus system, i.e. the way the CPU talks to the other stuff
	  inside your box.  Other bus systems are PCI, EISA, MicroChannel
	  (MCA) or VESA.  ISA is an older system, now being displaced by PCI;
	  newer boards don't support it.  If you have ISA, say Y, otherwise N.

config ATARI_ROM_ISA
	bool "Atari ROM port ISA adapter support"
	depends on ATARI
	help
	  This option enables support for the ROM port ISA adapter used to
	  operate ISA cards on Atari. Only 8  bit cards are supported, and
	  no interrupt lines are connected.
	  The only drivers currently using this adapter are the NE2000 ISA
	  driver for EtherNEC (RTL8019AS based NE2000 compatible network
	  cards), and drivers for the NetUSBee (RTL8019AS / ISP1160 ethernet/
	  USB combo card).

config ATARI_USB
	bool "Atari USB host controller support"
	depends on ATARI
	select USB_SUPPORT
	help
	  This option enables support for USB host controllers contained on
	  the EtherNAT and NetUSBee cards for Atari. You will have to select
	  an appropriate HCD driver in the USB section (the ISP1160 one is
	  the most commonly used one).
	  Support for the NetUSBee in the ISP116x host controller driver also
	  requires the ATARI_ROM_ISA option to be set.

source "drivers/zorro/Kconfig"

endif
```
